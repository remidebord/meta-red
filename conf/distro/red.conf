## conf/distro/red.conf
```bitbake
# Distro Layer configuration
# include and overwrite default poky distro

include conf/distro/poky.conf

DISTRO = "red"
DISTRO_NAME = "Red-Linux"
DISTRO_VERSION = "1.0"
SDK_VENDOR = "-redsdk"
SDK_VERSION="${DISTRO_VERSION}"
MAINTAINER = "remidebord@hotmail.fr"

TARGET_VENDOR = "-red"

PACKAGE_CLASSES = "package_ipk"

IMAGE_FEATURES_append = " debug-tweaks ssh-server-dropbear"
BAD_RECOMMENDATIONS += "openssh-sftp-server"

IMAGE_INSTALL_append = " devmem2"

# Add kernel sources to SDK
TOOLCHAIN_TARGET_TASK_append = " kernel-devsrc"

# Use systemd as init manager
DISTRO_FEATURES_append = " systemd"
DISTRO_FEATURES_BACKFILL_CONSIDERED += "sysvinit"
VIRTUAL-RUNTIME_init_manager = "systemd"
VIRTUAL-RUNTIME_initscripts = "systemd-compat-units"
```

## conf/layer.conf
```bitbake
# We have a conf and classes directory, add to BBPATH
BBPATH .= ":${LAYERDIR}"

# We have recipes-* directories, add to BBFILES
BBFILES += "${LAYERDIR}/recipes-*/*/*.bb \
            ${LAYERDIR}/recipes-*/*/*.bbappend"

BBFILE_COLLECTIONS += "meta-red"
BBFILE_PATTERN_meta-red = "^${LAYERDIR}/"
BBFILE_PRIORITY_meta-red = "6"

LAYERDEPENDS_meta-red = "core"
LAYERSERIES_COMPAT_meta-red = "kirkstone langdale"
```
